## boot/uboot/u-boot-2020.04/arch/arm/mach-axera/Kconfig
```kconfig
if ARCH_AXERA

config AXERA_INSTR_ARM
	bool "use ARM instruction set"
	default n
	help
	The AXERA AX620E use ARM instruction set

config AXERA_AX620E
	bool "Support AXERA AX620E"
	select CPU_V7A if AXERA_INSTR_ARM
	select ARM64 if !AXERA_INSTR_ARM
	help
	  The AXERA AX620E is a ARM-based SoC with quad-core Cortex-A53.
	  including NEON, 512KB L2 cache, two video interfaces supporting
	  HDMI, several LPDDR4 options and video codec support. Peripherals include
	  Gigabit Ethernet, USB2 host and OTG, SDIO, I2S, UARTs, SPI, I2C and PWMs.
	select OF_CONTROL
	select SUPPORT_SPL

config SYS_VENDOR
        default "axera"

config SYS_SOC
        default "axera"

source "arch/arm/mach-axera/ax620e/Kconfig"

endif
```

## boot/uboot/u-boot-2020.04/arch/arm/mach-axera/ax620e/Kconfig
```kconfig
if ARCH_AXERA

config TARGET_AX620E_HAPS
	bool "AX620E_HAPS evaluation board"
	help
	  AX620E_haps is a evaluation board for AXERA AX620e,
	  with full function and phisical connectors support like
	  usb2.0 host ports, JTAG, MAC, SDcard, HDMI, USB-2-serial...

config TARGET_AX620E_EMMC
	bool "AX620E_EMMC evaluation board"
	help
	  AX620E_haps is a evaluation board for AXERA AX620e,
	  with full function and phisical connectors support like
	  usb2.0 host ports, JTAG, MAC, SDcard, HDMI, USB-2-serial...

config TARGET_AX620E_NAND
        bool "AX620E_NAND evaluation board"
        help
          AX620E_haps is a evaluation board for AXERA AX620e,
          with full function and phisical connectors support like
          usb2.0 host ports, JTAG, MAC, SDcard, HDMI, USB-2-serial...

config TARGET_AX620E_NOR
        bool "AX620E_NOR evaluation board"
        help
          AX620E_haps is a evaluation board for AXERA AX620e,
          with full function and phisical connectors support like
          usb2.0 host ports, JTAG, MAC, SDcard, HDMI, USB-2-serial...

config TARGET_AX620E_QNAND
        bool "AX620E_QNAND evaluation board"
        help
          AX620E_haps is a evaluation board for AXERA AX620e,
          with full function and phisical connectors support like
          usb2.0 host ports, JTAG, MAC, SDcard, HDMI, USB-2-serial...

config AXERA_MEMORY_DUMP_EMMC
	bool "axera memory dump to emmc"
	depends on TARGET_AX620E_EMMC && FS_EXT4
	help
	  save dump file to emmc

config AXERA_AX630C_DDR4_RETRAIN
	bool "axera DDR4 retrain function support."
	depends on TARGET_AX620E_EMMC || TARGET_AX620E_NAND
	help
	  The AXERA AX620E_EMMC use DDR4 retrain function

config AX620Q_EMMC
	bool "axera AX620Q emmc support, diff for ddr size."
	depends on TARGET_AX620E_EMMC
	help
	  The AXERA AX620E_EMMC Distinguish different configurations of ddr size

config AXERA_MEMORY_DUMP_SD
	bool "axera memory dump to SDcard"
	depends on FS_FAT
	help
	  save dump file to SDcard

config AXERA_SUPPORT_MEMORY_DUMP
	bool "axera support memory dump"
	default y if AXERA_MEMORY_DUMP_SD || AXERA_MEMORY_DUMP_EMMC || AXERA_MEMORY_DUMP_USB_STORAGE
	help
	support memory dump

config SUPPORT_AB
	bool "axera AB partition support"
	depends on TARGET_AX620E_EMMC
	help
	  support ab partition

config AXERA_DTB_IMG_ADDR
	  hex "The kernel dtb addr is placed here."
	  depends on AXERA_AX620E
	  help
	    The AXERA AX620E use kernel dtb addr

config AXERA_KERNEL_IMG_ADDR
	  hex "The kernel addr is placed here."
	  depends on AXERA_AX620E
	  help
	    The AXERA AX620E use kernel addr

config SUPPORT_RECOVERY
	bool "axera RECOVERY support"
	help
	  support recovery

config BOOT_OPTIMIZATION_SUPPORT
	bool "axera fast boot to uboot support"
	help
	  support fast boot to uboot

source "board/axera/ax620e_haps/Kconfig"
source "board/axera/ax620e_emmc/Kconfig"
source "board/axera/ax620e_nand/Kconfig"
source "board/axera/ax620e_nor/Kconfig"
source "board/axera/ax620e_Qnand/Kconfig"

endif
```

## boot/uboot/u-boot-2020.04/board/axera/ax620e_Qnand/Kconfig
```kconfig
if TARGET_AX620E_QNAND

config SYS_BOARD
	default "ax620e_Qnand"

config SYS_VENDOR
	default "axera"

config SYS_CONFIG_NAME
	default "ax620e_Qnand"

config BOARD_SPECIFIC_OPTIONS # dummy
	def_bool y


endif
```

## boot/uboot/u-boot-2020.04/board/axera/ax620e_emmc/Kconfig
```kconfig
if TARGET_AX620E_EMMC

config SYS_BOARD
	default "ax620e_emmc"

config SYS_VENDOR
	default "axera"

config SYS_CONFIG_NAME
	default "ax620e_emmc"

config BOARD_SPECIFIC_OPTIONS # dummy
	def_bool y


endif
```

## boot/uboot/u-boot-2020.04/board/axera/ax620e_haps/Kconfig
```kconfig
if TARGET_AX620E_HAPS

config SYS_BOARD
	default "ax620e_haps"

config SYS_VENDOR
	default "axera"

config SYS_CONFIG_NAME
	default "ax620e_haps"

config BOARD_SPECIFIC_OPTIONS # dummy
	def_bool y


endif
```

## boot/uboot/u-boot-2020.04/board/axera/ax620e_nand/Kconfig
```kconfig
if TARGET_AX620E_NAND

config SYS_BOARD
	default "ax620e_nand"

config SYS_VENDOR
	default "axera"

config SYS_CONFIG_NAME
	default "ax620e_nand"

config BOARD_SPECIFIC_OPTIONS # dummy
	def_bool y


endif
```

## boot/uboot/u-boot-2020.04/board/axera/ax620e_nor/Kconfig
```kconfig
if TARGET_AX620E_NOR

config SYS_BOARD
	default "ax620e_nor"

config SYS_VENDOR
	default "axera"

config SYS_CONFIG_NAME
	default "ax620e_nor"

config BOARD_SPECIFIC_OPTIONS # dummy
	def_bool y


endif
```

## boot/uboot/u-boot-2020.04/cmd/axera/Kconfig
```kconfig
menu "Axera commands"

config CMD_AXERA_DOWNLOAD
	bool "download"
	default y
	help
	  Enable axera download function

config CMD_AXERA_MEMTEST
	bool "memtest"
	default y
	help
	  Integrated memory test.

config CMD_AXERA_CIPHER
	bool "cipher"
	default y
	help
	  Integrated cipher test.

config CMD_AXERA_BOOT
	bool "axera boot"
	default y
	help
	  Axera boot os from memory.

config CMD_AXERA_EXT4
	bool "axera ext4 command support"
	select FS_EXT4
	help
	  Enables axera EXT4 FS command

config AXERA_SECURE_BOOT
	bool "axera secureboot"
	default n
	help
	  Axera secureboot support.

config CMD_AXERA_SDUPDATE
	bool "axera sd update"
	default y
	help
	  Axera sd update image to storage.

config CMD_AXERA_SDBOOT
	bool "axera sd boot"
	default y
	help
	  Axera sd boot to kernel.

config CMD_AXERA_TFTP_OTA
	bool "axera tftp ota update"
	default n
	help
	  Axera tftp ota update image to storage.

config CMD_AXERA_UPDATE
	bool "axera update"
	default y
	help
	  Axera update image to storage.

config CMD_AXERA_EMMC_SCAN
	bool "axera emmc scan"
	default n
	help
	  Axera emmc scan for delayline.

config CMD_AXERA_BOOT_RISCV
	bool "axera riscv boot"
	default n
	help
	  Axera Risc-v fast boot

config CMD_AXERA_USB_STOR_UPDATE
	bool "axera usb storage update"
	default n
	help
	  Axera usb storage update image to storage.

config CMD_AXERA_GZIPD
	bool "axera gzipd"
	default y
	help
	  Axera gzipd function.

### SIPEED EDIT ###
config CMD_AXERA_KERNEL_LZMA
	bool "axera kernel lzma"
	default n
	help
	  Axera kernel lzma function.
### SIPEED EDIT END ###
endmenu
```

## boot/uboot/u-boot-2020.04/configs/AX630C_emmc_arm64_k419_defconfig
```kconfig
CONFIG_ARM=y
CONFIG_ARCH_AXERA=y
CONFIG_SYS_TEXT_BASE=0x5C000400
CONFIG_AXERA_AX620E=y
CONFIG_TARGET_AX620E_EMMC=y
CONFIG_SUPPORT_EMMC_BOOT=y
# CONFIG_PSCI_RESET is not set
CONFIG_FIT=y
CONFIG_DM_GPIO=y
CONFIG_DWAPB_GPIO=y
CONFIG_SYS_ARCH_TIMER=y
# CONFIG_ARCH_FIXUP_FDT_MEMORY is not set
# CONFIG_DISPLAY_CPUINFO is not set
CONFIG_BOARD_EARLY_INIT_F=y
CONFIG_SYS_PROMPT="AXERA-UBOOT=>"
CONFIG_UBOOT_SKIP_RELOCATE=y
CONFIG_CMD_BOOTZ=y
CONFIG_CMD_AXERA_DOWNLOAD=y
CONFIG_BOARD_LATE_INIT=y
CONFIG_CMD_AXERA_BOOT=y
CONFIG_AXERA_SECURE_BOOT=y
CONFIG_CMD_AXERA_SDUPDATE=y
CONFIG_CMD_AXERA_SDBOOT=y
CONFIG_CMD_AXERA_CIPHER=y
CONFIG_CMD_AXERA_TFTP_OTA=y
CONFIG_CMD_AXERA_USB_STOR_UPDATE=y
# CONFIG_CMD_UNZIP is not set
CONFIG_CMD_BIND=y
CONFIG_CMD_DM=y
CONFIG_CMD_GPT=y
CONFIG_CMD_MMC=y
CONFIG_CMD_MTD=y
CONFIG_CMD_AXERA_EXT4=y
# CONFIG_CMD_NAND is not set
# CONFIG_CMD_SETEXPR is not set
CONFIG_CMD_DHCP=y
CONFIG_CMD_TFTPPUT=y
CONFIG_CMD_MII=y
CONFIG_CMD_PING=y
CONFIG_CMD_TIME=y
CONFIG_CMD_FAT=y
CONFIG_CMD_EXT4=y
CONFIG_CMD_EXT4_WRITE=y
CONFIG_FS_EXT4=y
CONFIG_EXT4_WRITE=y
CONFIG_CMD_FS_GENERIC=y
CONFIG_CMD_MTDPARTS=y
CONFIG_CMD_MTDPARTS_SPREAD=y
CONFIG_CMD_MTDPARTS_SHOW_NET_SIZES=y
CONFIG_DEFAULT_DEVICE_TREE="AX620E_emmc"
# CONFIG_ENV_IS_IN_NAND is not set
CONFIG_ENV_IS_IN_MMC=y
CONFIG_CMD_ERASEENV=y
CONFIG_CMD_CACHE=y
CONFIG_NET_RANDOM_ETHADDR=y
CONFIG_REGMAP=y
CONFIG_SYSCON=y
CONFIG_CLK=y
CONFIG_AXERA_DMA=y
CONFIG_AXERA_DMAPER=y
CONFIG_DM_MMC=y
CONFIG_MMC_SDHCI_SDMA=y
CONFIG_MMC_SDHCI_AX620E=y
CONFIG_MTD=y
CONFIG_DM_MTD=y
CONFIG_MTD_RAW_NAND=y
CONFIG_SYS_NAND_USE_FLASH_BBT=y
CONFIG_MTD_SPI_NAND=y
CONFIG_DM_SPI_FLASH=y
CONFIG_SF_DEFAULT_CS=1
CONFIG_SPI_FLASH_GIGADEVICE=y
CONFIG_SPI_FLASH_MACRONIX=y
CONFIG_SPI_FLASH_WINBOND=y
CONFIG_SPI_FLASH_MTD=y
CONFIG_PHY_MARVELL=y
CONFIG_PHY_REALTEK=y
CONFIG_CMD_NET=y
CONFIG_DM_ETH=y
CONFIG_AXERA_EMAC=y
# CONFIG_AXERA_EMAC_HAPS is not set
CONFIG_MII=y
CONFIG_NETDEVICES=y
CONFIG_PINCTRL=y
CONFIG_DM_PWM=y
CONFIG_PWM_AXERA=y
CONFIG_BAUDRATE=115200
CONFIG_CONS_INDEX=1
CONFIG_SYS_NS16550=y
CONFIG_SPI=y
CONFIG_DM_SPI=y
CONFIG_AXERA_SPI=y
CONFIG_SYSRESET=y
CONFIG_FS_FAT=y
CONFIG_FAT_WRITE=y
CONFIG_ERRNO_STR=y
CONFIG_CMD_PWM=y
### below for ubifs###
CONFIG_CMD_UBI=y
CONFIG_CMD_UBIFS=y
CONFIG_MTD_UBI=y
CONFIG_MTD_UBI_WL_THRESHOLD=4096
CONFIG_MTD_UBI_BEB_LIMIT=20
CONFIG_RBTREE=y
CONFIG_LZO=y
CONFIG_POSITION_INDEPENDENT=y
###above for ubifs###
# CONFIG_AXERA_ENV_BOARD_ID is not set
CONFIG_ARMV8_SWITCH_TO_EL1=y
### below for boot logo###
CONFIG_DM_VIDEO=y
CONFIG_DISPLAY=y
CONFIG_VIDEO_AXERA=y
CONFIG_VIDEO_AXERA_MAX_XRES=2048
CONFIG_VIDEO_AXERA_MAX_YRES=2048
CONFIG_VIDEO_AXERA_DISPLAY_WIDTH=800
CONFIG_VIDEO_AXERA_DISPLAY_HEIGHT=480
CONFIG_DISPLAY_AXERA_DPI=y
# CONFIG_DISPLAY_AXERA_MIPI is not set
### above for boot logo ###
# adc #
CONFIG_DM=y
CONFIG_CMD_ADC=y
CONFIG_ADC=y
CONFIG_ADC_AXERA=y
#thermal#
CONFIG_DM_THERMAL=y
# gpio #
CONFIG_AXERA_GPIO=y
CONFIG_CMD_GPIO=y
CONFIG_GPIO=y

# ddr #
CONFIG_AX620E_DRAM=y

# USB #
CONFIG_USB=y
CONFIG_DM_USB=y
CONFIG_USB_HOST=y
CONFIG_USB_XHCI_HCD=y
CONFIG_USB_XHCI_DWC3=y
CONFIG_USB_DWC3=y
CONFIG_USB_DWC3_AXERA=y
CONFIG_USB_STORAGE=y
CONFIG_CMD_USB=y

# GZIPD #
CONFIG_CMD_AXERA_GZIPD=y

#I2C#
CONFIG_DM_I2C=y
CONFIG_CMD_I2C=y
CONFIG_SYS_I2C_DW=y
```

## boot/uboot/u-boot-2020.04/drivers/video/axera/Kconfig
```kconfig
#**********************************************************************************
#* Copyright (c) 2019-2020 Beijing AXera Technology Co., Ltd. All Rights Reserved.
#*
#* This source file is the property of Beijing AXera Technology Co., Ltd. and
#* may not be copied or distributed in any isomorphic form without the prior
#* written consent of Beijing AXera Technology Co., Ltd.
#*
#**********************************************************************************/

menuconfig VIDEO_AXERA
	bool "Enable AXERA Video Support"
	depends on DM_VIDEO
	help
	  AXERA SoCs provide video output capabilities for High-Definition
	  Multimedia Interface (HDMI), Low-voltage Differential Signalling
	  (LVDS), embedded DisplayPort (eDP) and Display Serial Interface (DSI).

	  This driver supports the on-chip video output device, and targets AXERA.

config VIDEO_AXERA_MAX_XRES
        int "Maximum horizontal resolution (for memory allocation purposes)"
	depends on VIDEO_AXERA
	default 2048
	help
	  The maximum horizontal resolution to support for the framebuffer.
	  This configuration is used for reserving/allocating memory for the
	  framebuffer during device-model binding/probing.

config VIDEO_AXERA_MAX_YRES
        int "Maximum vertical resolution (for memory allocation purposes)"
	depends on VIDEO_AXERA
	default 2048
	help
	  The maximum vertical resolution to support for the framebuffer.
	  This configuration is used for reserving/allocating memory for the
	  framebuffer during device-model binding/probing.

config VIDEO_AXERA_DISPLAY_WIDTH
        int "display horizontal resolution (for screen)"
	depends on VIDEO_AXERA
	default 800
	help
	  The display width for screen show.

config VIDEO_AXERA_DISPLAY_HEIGHT
        int "display vertical resolution (for screen)"
	depends on VIDEO_AXERA
	default 480
	help
	  The display height for screen show.

if VIDEO_AXERA

choice
	prompt "Select display port"
	default DISPLAY_AXERA_DPI
	help
	  Choose the display port

	config DISPLAY_AXERA_DPI
		bool "DPI Port"
		depends on VIDEO_AXERA
		help
		  This enables DPI display support.

	config DISPLAY_AXERA_MIPI
		bool "MIPI Port"
		depends on VIDEO_AXERA
		help
		  This enables Mobile Industry Processor Interface(MIPI) display support.

	config DISPLAY_AXERA_BT656
		bool "BT656 Port"
		depends on VIDEO_AXERA
		help
		  This enables BT656 display support.

endchoice
endif
```
