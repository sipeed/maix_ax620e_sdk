## boot/uboot/u-boot-2020.04/configs/AX620Q_emmc_arm32_k419_sipeed_nanoagent_defconfig
```kconfig
CONFIG_ARM=y
CONFIG_SYS_ARCH_TIMER=y
CONFIG_ARCH_AXERA=y
CONFIG_SYS_TEXT_BASE=0x44000400
CONFIG_ENV_SIZE=0x100000
CONFIG_ENV_OFFSET=0x440000
CONFIG_DM_GPIO=y
CONFIG_AXERA_INSTR_ARM=y
CONFIG_AXERA_AX620E=y
CONFIG_TARGET_AX620E_EMMC=y
CONFIG_AX620Q_EMMC=y
CONFIG_AXERA_DTB_IMG_ADDR=0x42008000
CONFIG_AXERA_KERNEL_IMG_ADDR=0x40008000
CONFIG_PHYS_64BIT=y
CONFIG_FIT=y
# CONFIG_ARCH_FIXUP_FDT_MEMORY is not set
# CONFIG_CONSOLE_MUX is not set
CONFIG_BOARD_LATE_INIT=y
# CONFIG_DISPLAY_CPUINFO is not set
CONFIG_BOARD_EARLY_INIT_F=y
CONFIG_SYS_PROMPT="AXERA-UBOOT=>"
CONFIG_CMD_BOOTZ=y
# CONFIG_CMD_ELF is not set
# CONFIG_CMD_IMI is not set
# CONFIG_CMD_XIMG is not set
CONFIG_CMD_ERASEENV=y
# CONFIG_CMD_AXERA_MEMTEST is not set
CONFIG_AXERA_SECURE_BOOT=y
CONFIG_CMD_AXERA_TFTP_OTA=y
CONFIG_CMD_AXERA_USB_STOR_UPDATE=y
CONFIG_CMD_LZMADEC=y
CONFIG_CMD_ADC=y
CONFIG_CMD_BIND=y
CONFIG_CMD_DM=y
CONFIG_CMD_GPIO=y
# CONFIG_CMD_LOADB is not set
# CONFIG_CMD_LOADS is not set
CONFIG_CMD_MMC=y
CONFIG_CMD_MTD=y
CONFIG_CMD_USB=y
# CONFIG_CMD_ITEST is not set
# CONFIG_CMD_SOURCE is not set
# CONFIG_CMD_SETEXPR is not set
CONFIG_CMD_NET=y
CONFIG_CMD_DHCP=y
CONFIG_CMD_TFTPPUT=y
CONFIG_CMD_MII=y
CONFIG_CMD_PING=y
CONFIG_CMD_CACHE=y
CONFIG_CMD_TIME=y
CONFIG_CMD_FAT=y
CONFIG_CMD_MTDPARTS=y
CONFIG_CMD_MTDPARTS_SPREAD=y
CONFIG_CMD_MTDPARTS_SHOW_NET_SIZES=y
CONFIG_CMD_PWM=y
CONFIG_CMD_UBI=y
CONFIG_EFI_PARTITION=y
CONFIG_DEFAULT_DEVICE_TREE="AX620E_emmc_nanoagent"
CONFIG_ENV_IS_IN_MMC=y
CONFIG_NET_RANDOM_ETHADDR=y
CONFIG_REGMAP=y
CONFIG_SYSCON=y
CONFIG_ADC_AXERA=y
CONFIG_CLK=y
CONFIG_AXERA_DMA=y
CONFIG_AXERA_DMAPER=y
CONFIG_AXERA_GPIO=y
# CONFIG_INPUT is not set
CONFIG_DM_MMC=y
CONFIG_SUPPORT_EMMC_BOOT=y
CONFIG_MMC_SDHCI_SDMA=y
CONFIG_MMC_SDHCI_AX620E=y
CONFIG_MTD=y
CONFIG_DM_MTD=y
CONFIG_PHY_MARVELL=y
CONFIG_PHY_REALTEK=y
CONFIG_DM_ETH=y
CONFIG_AXERA_EMAC=y
CONFIG_MII=y
CONFIG_PINCTRL=y
CONFIG_DM_PWM=y
CONFIG_PWM_AXERA=y
CONFIG_CONS_INDEX=4
CONFIG_SYS_NS16550=y
CONFIG_SPI=y
CONFIG_DM_SPI=y
CONFIG_SPI_MEM=y
CONFIG_AXERA_SPI=y
CONFIG_SYSRESET=y
CONFIG_USB=y
CONFIG_DM_USB=y
CONFIG_USB_XHCI_HCD=y
CONFIG_USB_XHCI_DWC3=y
CONFIG_USB_DWC3=y
CONFIG_USB_DWC3_AXERA=y
CONFIG_USB_STORAGE=y
CONFIG_DM_VIDEO=y
CONFIG_VIDEO_AXERA=y
CONFIG_VIDEO_AXERA_DISPLAY_WIDTH=640
CONFIG_DISPLAY_AXERA_MIPI=y
CONFIG_FAT_WRITE=y
# CONFIG_REGEX is not set
CONFIG_ERRNO_STR=y
# CONFIG_EFI_LOADER is not set
```
